## conf/distro/lat.conf
```bitbake
DISTRO_FEATURES:append = ' lat'
DISTRO_FEATURES_NATIVESDK:append = ' lat'
DISTRO_FEATURES_NATIVE:append = ' lat'

# Vbox Guest Additions
COMPATIBLE_MACHINE:pn-vboxguestdrivers = "intel-x86-64"
EXTRA_IMAGEDEPENDS:append:intel-x86-64 = " vboxguestdrivers"

LAT_DEFAULT_IMAGE ?= "lat-image-base"

VIRTUAL-RUNTIME_base-utils = "packagegroup-core-base-utils"

# Disable multilib
MULTILIBS = ""
baselib = "lib"

# For docker
DISTRO_FEATURES:append = " virtualization"

IMAGE_CLASSES:append = " lat_sdk"

BOOTFILES ??= ""

# OSTree related settings
OSTREE_OSNAME ??= "lat_os"

OSTREE_SUPPORTED_ARM64_MACHINES ??= " \
    bcm-2xxx-rpi4 \
    xilinx-zynqmp \
    nxp-imx8 \
    marvell-cn96xx \
    nxp-s32g \
    intel-socfpga-64 \
    ti-j72xx \
    aptiv_cvc_sousa \
    aptiv-cvc-fl \
    axxiaarm64 \
    nxp-ls1043 \
    nxp-lx2xxx \
"

OSTREE_SUPPORTED_ARM32_MACHINES ??= " \
    xilinx-zynq \
    nxp-imx6 \
    nxp-ls1028 \
    axxiaarm \
"

OSTREE_SUPPORTED_ARM_MACHINES ?= " \
    ${OSTREE_SUPPORTED_ARM64_MACHINES} \
    ${OSTREE_SUPPORTED_ARM32_MACHINES} \
"

OSTREE_WIFI_PACKAGES ??= ""
OSTREE_WIFI_PACKAGES:intel-x86-64 = " \
    packagegroup-base-wifi \
    linux-firmware-iwlwifi-6000g2a-6 \
    linux-firmware-iwlwifi-6000g2b-6 \
    linux-firmware-iwlwifi-135-6 \
    linux-firmware-iwlwifi-8000c \
    linux-firmware-iwlwifi-8265 \
    linux-firmware-iwlwifi-7265d \
    linux-firmware-iwlwifi-9000 \
    linux-firmware-iwlwifi-misc \
    kernel-module-iwlmvm \
    kernel-module-iwlwifi \
"
```

## conf/layer.conf
```bitbake
# We have a conf and classes directory, add to BBPATH
BBPATH =. "${LAYERDIR}:"

# We have recipes-* directories, add to BBFILES
BBFILES += " \
    ${LAYERDIR}/recipes-*/*/*.bb \
    ${LAYERDIR}/recipes-*/*/*.bbappend"

BBFILE_COLLECTIONS += "lat-layer"
BBFILE_PATTERN_lat-layer = "^${LAYERDIR}/"
BBFILE_PRIORITY_lat-layer = "6"

LAYERDEPENDS_lat-layer = " \
    core \
    openembedded-layer \
    filesystems-layer \
    meta-python \
    virtualization-layer \
    networking-layer \
    xfce-layer \
    gnome-layer \
    multimedia-layer \
    ${@bb.utils.contains('DISTRO_FEATURES', 'efi-secure-boot', 'efi-secure-boot', '', d)} \
"

LAYERSERIES_COMPAT_lat-layer = "scarthgap"

LAYER_PATH_lat-layer = "${LAYERDIR}"
```
